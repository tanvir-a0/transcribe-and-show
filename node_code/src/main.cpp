#include <Arduino.h>
#include <Wire.h>

// User specified pins
#define SDA_PIN 21
#define SCL_PIN 19
#define OLED_ADDR 0x3C
#define I2C_FREQ 400000 // Fast Mode 400kHz

// Command macro
void sendCommand(uint8_t command) {
  Wire.beginTransmission(OLED_ADDR);
  Wire.write(0x00); // Control byte: Co = 0, D/C = 0 (Command)
  Wire.write(command);
  Wire.endTransmission();
}

void initOLED() {
  Wire.begin(SDA_PIN, SCL_PIN, I2C_FREQ);
  
  // Universal Initialization sequence for both SSD1306 and SH1106 (1.3" OLEDs)
  sendCommand(0xAE); // Display OFF
  sendCommand(0xD5); // Set Display Clock Divide Ratio
  sendCommand(0x80); // Default
  sendCommand(0xA8); // Set Multiplex Ratio
  sendCommand(0x3F); // 64MUX (for 128x64)
  sendCommand(0xD3); // Set Display Offset
  sendCommand(0x00); // 0
  sendCommand(0x40); // Set Display Start Line (0)
  sendCommand(0x8D); // Charge Pump Setting
  sendCommand(0x14); // Enable charge pump
  sendCommand(0x20); // Set Memory Addressing Mode
  sendCommand(0x02); // *** PAGE ADDRESSING MODE ***
  sendCommand(0xA1); // Set Segment Re-map (flip horizontal)
  sendCommand(0xC8); // Set COM Output Scan Direction (flip vertical)
  sendCommand(0xDA); // Set COM Pins Hardware Configuration
  sendCommand(0x12); // Alternative COM pin config for 128x64
  sendCommand(0x81); // Set Contrast Control
  sendCommand(0xCF); // High contrast
  sendCommand(0xD9); // Set Pre-charge Period
  sendCommand(0xF1);
  sendCommand(0xDB); // Set VCOMH Deselect Level
  sendCommand(0x40);
  sendCommand(0xA4); // Entire Display ON (resume)
  sendCommand(0xA6); // Normal Display (not inverted)
  sendCommand(0xAF); // Display ON
}

// Pre-rendered 128x64 image containing the text "Hello,\nWorld!"
const uint8_t splashScreen[1024] PROGMEM = {0x00, 0x00, 0x00, 0x00, 0x00, 0x00, 0x00, 0x00, 0x00, 0x00, 0x00, 0x00, 0x00,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 0x00, 0x00};

// Function to draw an image from PROGMEM directly to the screen
void drawImageFromPROGMEM(const uint8_t* image) {
  for (uint8_t page = 0; page < 8; page++) {
    sendCommand(0xB0 + page);
    sendCommand(0x02); // Offset by 2 columns for SH1106 OLEDs
    sendCommand(0x10);
    
    for (int chunk = 0; chunk < 2; chunk++) {
      Wire.beginTransmission(OLED_ADDR);
      Wire.write(0x40); 
      for (int i = 0; i < 64; i++) {
        int bufferIndex = (page * 128) + (chunk * 64) + i;
        Wire.write(pgm_read_byte(&image[bufferIndex]));
      }
      Wire.endTransmission();
    }
  }
}

void setup() {
  Serial.begin(1000000); 
  Serial.setTimeout(100); 
  
  initOLED();
  
  // Show "Hello, World!" splash screen immediately on boot
  drawImageFromPROGMEM(splashScreen);
  
  // Handshake: Tell Python that ESP32 is ready to receive the video stream
  Serial.write('K');
}

uint8_t frameBuffer[1024];
bool findingHeader = true;
uint8_t lastByte = 0x00;

void drawFrame() {
  for (uint8_t page = 0; page < 8; page++) {
    sendCommand(0xB0 + page);
    sendCommand(0x02); // Offset by 2 columns for SH1106 OLEDs
    sendCommand(0x10);
    
    for (int chunk = 0; chunk < 2; chunk++) {
      Wire.beginTransmission(OLED_ADDR);
      Wire.write(0x40); 
      for (int i = 0; i < 64; i++) {
        int bufferIndex = (page * 128) + (chunk * 64) + i;
        Wire.write(frameBuffer[bufferIndex]);
      }
      Wire.endTransmission();
    }
  }
}

void loop() {
  if (Serial.available() > 0) {
    if (findingHeader) {
      uint8_t b = Serial.read();
      if (lastByte == 0xAA && b == 0x55) {
        findingHeader = false; 
      }
      lastByte = b;
    } else {
      int bytesRead = Serial.readBytes((char*)frameBuffer, 1024);
      
      if (bytesRead == 1024) {
        // Once video data arrives, this overwrites the Hello World screen
        drawFrame();
        
        // Handshake: Send 'K' back to request next frame
        Serial.write('K');
      }
      
      findingHeader = true;
      lastByte = 0x00;
    }
  }
}